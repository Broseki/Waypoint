## main/Kconfig.projbuild
```kconfig
menu "Waypoint Device Configuration"

    orsource "$IDF_PATH/examples/common_components/env_caps/$IDF_TARGET/Kconfig.env_caps"

    config BLINK_GPIO
        int "Blink GPIO number"
        range ENV_GPIO_RANGE_MIN ENV_GPIO_OUT_RANGE_MAX
        default 15
        help
            GPIO number (IOxx) to blink on and off the LED.
            Some GPIOs are used for other purposes (flash connections, etc.) and cannot be used to blink.
    
    config WIFI_SSID
        string "WiFi SSID"
        default "your-ssid"
        help
            The SSID of the WiFi network to connect to.
            This is used for connecting to the network to send and receive data.
    
    config WIFI_PASSWORD
        string "WiFi Password"
        default "your-password"
        help
            The password for the WiFi network.
    
    config MQTT_KEY
        string "MQTT Key"
        default "your-mqtt-key"
        help
            The key used for MQTT authentication.
    
    config MQTT_SERVER
        string "MQTT Server"
        default "mqtt.example.com"
        help
            The address of the MQTT server to connect to.
            This is used for sending and receiving messages over MQTT.
    
    config MQTT_PORT
        int "MQTT Port"
        range 1 65535
        default 1883
        help
            The port number of the MQTT server.

endmenu
```
